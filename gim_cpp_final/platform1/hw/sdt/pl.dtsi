/ {
	amba_pl: amba_pl {
		ranges;
		compatible = "simple-bus";
		#address-cells = <1>;
		#size-cells = <1>;
		accelerator_0: accelerator@40000000 {
			compatible = "xlnx,accelerator-1.0";
			xlnx,ii = "16 , ~ , 97519";
			xlnx,s-axi-control-addr-width = <7>;
			xlnx,machine = <64>;
			xlnx,rable = <0>;
			xlnx,ip-name = "accelerator";
			reg = <0x40000000 0x10000>;
			clocks = <&clkc 15>;
			xlnx,clk-period = <10>;
			xlnx,s-axi-control-data-width = <32>;
			xlnx,edk-iptype = "PERIPHERAL";
			status = "okay";
			clock-names = "ap_clk";
			xlnx,combinational = <0>;
			xlnx,latency = <15>;
			xlnx,name = "accelerator_0";
		};
	};
};
